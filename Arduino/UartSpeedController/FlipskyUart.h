#ifndef FLIPSKY_UART_H
#define FLIPSKY_UART_H

#include <Arduino.h>

// FT85BD UART protocol (ftesc_v1.4_1.5_1.6_uart_handle.c)
enum FlipskyUartCommand : uint8_t {
  FTESC_UART_OBTAIN_DATA_ONCE = 0,
  FTESC_UART_CAN_FORWARD = 16,
  FTESC_UART_OBTAIN_FIRMWARE_VERSION = 17,
  FTESC_UART_KEEP_LIVE = 25,
};

class FlipskyUart {
public:
  void begin(HardwareSerial &serial, unsigned long baud = 115200,
             int8_t rxPin = -1, int8_t txPin = -1) {
    port_ = &serial;
#if defined(ARDUINO_ARCH_ESP32)
    if (rxPin >= 0 && txPin >= 0) {
      port_->begin(baud, SERIAL_8N1, rxPin, txPin);
    } else {
      port_->begin(baud);
    }
#else
    (void)rxPin;
    (void)txPin;
    port_->begin(baud);
#endif
    resetRxState();
  }

  void poll() {
    while (port_->available()) {
      const uint8_t b = port_->read();
      rxBytes_++;
      if (lastRawLen_ < sizeof(lastRaw_)) {
        lastRaw_[lastRawLen_++] = b;
      }
      processByte(b);
    }
  }

  uint32_t rxBytes() const { return rxBytes_; }
  void clearRxBytes() { rxBytes_ = 0; }

  uint8_t lastRawLen() const { return lastRawLen_; }
  const uint8_t *lastRaw() const { return lastRaw_; }
  void clearLastRaw() { lastRawLen_ = 0; }

  bool sendFwVersion() {
    return sendCommand(FTESC_UART_OBTAIN_FIRMWARE_VERSION);
  }

  bool sendAlive() { return sendCommand(FTESC_UART_KEEP_LIVE); }

  bool requestTelemetry(uint8_t canId = 0) {
    if (canId == 0) {
      return sendCommand(FTESC_UART_OBTAIN_DATA_ONCE);
    }

    uint8_t payload[2];
    payload[0] = FTESC_UART_CAN_FORWARD;
    payload[1] = canId;
    return sendPayload(payload, sizeof(payload));
  }

  bool hasTelemetry() const { return telemetryValid_; }
  void clearTelemetryFlag() { telemetryValid_ = false; }

  int32_t erpm() const { return rpm_; }
  float inputVoltage() const { return inputVoltage_; }
  float motorCurrent() const { return motorCurrent_; }
  uint8_t faultCode() const { return faultCode_; }
  uint8_t controllerId() const { return controllerId_; }

  bool hasFwVersion() const { return fwValid_; }
  uint8_t fwMajor() const { return fwMajor_; }
  uint8_t fwMinor() const { return fwMinor_; }

private:
  HardwareSerial *port_ = nullptr;

  bool telemetryValid_ = false;
  int32_t rpm_ = 0;
  float inputVoltage_ = 0.0f;
  float motorCurrent_ = 0.0f;
  uint8_t faultCode_ = 0;
  uint8_t controllerId_ = 0;

  bool fwValid_ = false;
  uint8_t fwMajor_ = 0;
  uint8_t fwMinor_ = 0;

  uint32_t rxBytes_ = 0;
  uint8_t lastRaw_[16] = {};
  uint8_t lastRawLen_ = 0;

  static const uint8_t RX_BUF_SIZE = 128;
  uint8_t rxBuf_[RX_BUF_SIZE];
  uint8_t rxLen_ = 0;
  uint16_t rxExpected_ = 0;
  bool rxActive_ = false;

  static uint16_t crc16Ftesc(const uint8_t *buf, uint16_t len) {
    static const uint8_t crcHiTable[] = {
        0x00, 0xC1, 0x81, 0x40, 0x01, 0xC0, 0x80, 0x41, 0x01, 0xC0, 0x80, 0x41,
        0x00, 0xC1, 0x81, 0x40, 0x01, 0xC0, 0x80, 0x41, 0x00, 0xC1, 0x81, 0x40,
        0x00, 0xC1, 0x81, 0x40, 0x01, 0xC0, 0x80, 0x41, 0x01, 0xC0, 0x80, 0x41,
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        0x00, 0xC1, 0x81, 0x40};
    static const uint8_t crcLoTable[] = {
        0x00, 0xC0, 0xC1, 0x01, 0xC3, 0x03, 0x02, 0xC2, 0xC6, 0x06, 0x07, 0xC7,
        0x05, 0xC5, 0xC4, 0x04, 0xCC, 0x0C, 0x0D, 0xCD, 0x0F, 0xCF, 0xCE, 0x0E,
        0x0A, 0xCA, 0xCB, 0x0B, 0xC9, 0x09, 0x08, 0xC8, 0xD8, 0x18, 0x19, 0xD9,
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        0x41, 0x81, 0x80, 0x40};

    uint8_t crcHi = 0xFF;
    uint8_t crcLo = 0xFF;
    while (len--) {
      const uint8_t index = crcLo ^ *buf++;
      crcLo = crcHi ^ crcHiTable[index];
      crcHi = crcLoTable[index];
    }
    return (uint16_t)((uint16_t)crcHi << 8 | crcLo);
  }

  static int16_t readI16(const uint8_t *data, int32_t &index) {
    const int16_t value = (int16_t)(((uint16_t)data[index] << 8) |
                                    (uint16_t)data[index + 1]);
    index += 2;
    return value;
  }

  static int32_t readI32(const uint8_t *data, int32_t &index) {
    const int32_t value = ((int32_t)data[index] << 24) |
                          ((int32_t)data[index + 1] << 16) |
                          ((int32_t)data[index + 2] << 8) |
                          (int32_t)data[index + 3];
    index += 4;
    return value;
  }

  static float readF16(const uint8_t *data, float scale, int32_t &index) {
    return (float)readI16(data, index) / scale;
  }

  static float readF32(const uint8_t *data, float scale, int32_t &index) {
    return (float)readI32(data, index) / scale;
  }

  bool sendCommand(uint8_t command) {
    return sendPayload(&command, 1);
  }

  bool sendPayload(const uint8_t *payload, uint8_t len) {
    if (port_ == nullptr || payload == nullptr || len == 0 || len > 255) {
      return false;
    }

    uint8_t frame[260];
    uint8_t count = 0;
    const uint16_t crc = crc16Ftesc(payload, len);

    frame[count++] = 0xAA;
    frame[count++] = len;
    memcpy(&frame[count], payload, len);
    count += len;
    frame[count++] = (uint8_t)(crc >> 8);
    frame[count++] = (uint8_t)(crc & 0xFF);
    frame[count++] = 0xDD;

    port_->write(frame, count);
    return true;
  }

  void resetRxState() {
    rxActive_ = false;
    rxLen_ = 0;
    rxExpected_ = 0;
  }

  void processByte(uint8_t b) {
    if (!rxActive_) {
      if (b == 0xAA || b == 0xBB) {
        rxBuf_[0] = b;
        rxLen_ = 1;
        rxExpected_ = 0;
        rxActive_ = true;
      }
      return;
    }

    if (rxLen_ >= RX_BUF_SIZE) {
      resetRxState();
      return;
    }

    rxBuf_[rxLen_++] = b;

    if (rxExpected_ == 0) {
      if (rxBuf_[0] == 0xAA) {
        rxExpected_ = (uint16_t)rxBuf_[1] + 3;
      } else {
        rxExpected_ = (uint16_t)(((uint16_t)rxBuf_[1] << 8) | rxBuf_[2]) + 4;
      }
      return;
    }

    const uint16_t headerLen = (rxBuf_[0] == 0xAA) ? 2 : 3;
    if (rxLen_ >= headerLen + rxExpected_) {
      handleFrame(rxBuf_, rxLen_);
      resetRxState();
    }
  }

  void handleFrame(const uint8_t *frame, uint8_t frameLen) {
    uint16_t dataLen = 0;
    const uint8_t *data = nullptr;

    if (frame[0] == 0xAA) {
      if (frameLen < 5) {
        return;
      }
      dataLen = frame[1];
      data = frame + 2;
    } else if (frame[0] == 0xBB) {
      if (frameLen < 6) {
        return;
      }
      dataLen = ((uint16_t)frame[1] << 8) | frame[2];
      data = frame + 3;
    } else {
      return;
    }

    if (frameLen < dataLen + 5) {
      return;
    }

    const uint16_t rxCrc =
        ((uint16_t)data[dataLen] << 8) | (uint16_t)data[dataLen + 1];
    if (crc16Ftesc(data, dataLen) != rxCrc) {
      return;
    }
    if (data[dataLen + 2] != 0xDD) {
      return;
    }

    const uint8_t cmd = data[0];
    int32_t index = 1;

    switch (cmd) {
      case FTESC_UART_OBTAIN_DATA_ONCE:
        if (dataLen < 29) {
          return;
        }
        controllerId_ = data[index++];
        faultCode_ = data[index++];
        inputVoltage_ = readF16(data, 100.0f, index);
        (void)readF32(data, 1000000.0f, index); // input current
        motorCurrent_ = readF32(data, 1000000.0f, index);
        rpm_ = readI32(data, index);
        telemetryValid_ = true;
        break;

      case FTESC_UART_OBTAIN_FIRMWARE_VERSION:
        if (dataLen >= 3) {
          fwMajor_ = data[1];
          fwMinor_ = data[2];
          fwValid_ = true;
        }
        break;

      default:
        break;
    }
  }
};

#endif
